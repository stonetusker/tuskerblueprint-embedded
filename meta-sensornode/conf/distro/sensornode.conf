## meta-sensornode/conf/distro/sensornode.conf
```bitbake
require conf/distro/poky.conf

DISTRO = "sensornode"
DISTRO_NAME = "Stonetusker SensorNode"
DISTRO_VERSION = "0.3"
DISTRO_CODENAME = "blueprint"

DISTRO_FEATURES:append = " systemd usrmerge ipv4 ipv6"
DISTRO_FEATURES:remove = " x11 wayland pulseaudio bluetooth nfc"
VIRTUAL-RUNTIME_init_manager = "systemd"
VIRTUAL-RUNTIME_initscripts = ""
VIRTUAL-RUNTIME_login_manager = "shadow-base"

PACKAGE_CLASSES ?= "package_ipk"
EXTRA_IMAGE_FEATURES ?= ""
INHERIT += "buildhistory"
BUILDHISTORY_COMMIT = "0"

# Release builds override this with the Git-derived artifact identity.
SENSORNODE_IMAGE_VERSION ?= "${DISTRO_VERSION}-${DATETIME}"
```

## meta-sensornode/conf/layer.conf
```bitbake
BBPATH .= ":${LAYERDIR}"
BBFILES += "${LAYERDIR}/recipes-*/*/*.bb ${LAYERDIR}/recipes-*/*/*.bbappend"

BBFILE_COLLECTIONS += "sensornode"
BBFILE_PATTERN_sensornode = "^${LAYERDIR}/"
BBFILE_PRIORITY_sensornode = "8"

LAYERSERIES_COMPAT_sensornode = "scarthgap"
LAYERDEPENDS_sensornode = "core openembedded-layer"

# Mender integration recipes are only parsed when meta-mender-core is in the build.
BBFILES_DYNAMIC += " \
    mender:${LAYERDIR}/dynamic-layers/mender/recipes-*/*/*.bb \
    mender:${LAYERDIR}/dynamic-layers/mender/recipes-*/*/*.bbappend \
"
```
